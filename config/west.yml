## config/west.yml
```yaml
manifest:
  remotes:
    - name: skubmdi
      url-base: https://github.com/skubmdi
  projects:
    - name: zmk-keyboard-uollp
      remote: skubmdi
      revision: v0.3
      import: west.yml
  self:
    path: config
```
